## Kconfig
```kconfig
rsource "dongle_split_recovery/Kconfig"
rsource "layer_sync/Kconfig"
rsource "battery_sync/Kconfig"
rsource "trackpad/Kconfig"
```

## battery_sync/Kconfig
```kconfig
config ZMK_BATTERY_SYNC
    bool "Mirror the right battery level to the left display"
    default y
    depends on ZMK_SPLIT_BLE && DT_HAS_ZMK_BEHAVIOR_BATTERY_SYNC_ENABLED
```

## config/dongle_split_recovery/Kconfig
```kconfig
# Split BLE bond recovery options. Provides two complementary self-healing
# paths so a desync between the dongle (central) and a Hillside View half
# (peripheral) can recover without reflashing:
#
#   1. DONGLE_BOND_AUTOHEAL - automatic on the dongle, reacts to BLE
#      security failures (bond/encryption desync).
#
#   2. PERIPHERAL_BOOT_BONDCLEAR - user-triggered on a half, reacts to a
#      key combo held at boot. Covers the case where the BLE link is up
#      but no input flows (GATT/CCC desync), which the dongle hook
#      cannot detect on its own.

menu "Dongle / split BLE bond recovery"

config DONGLE_BOND_AUTOHEAL
    bool "Dongle: auto-clear stale split bonds on BLE security failure"
    depends on BT && BT_SMP && ZMK_SPLIT && ZMK_SPLIT_ROLE_CENTRAL
    help
      When the dongle (central) connects to a split peripheral and
      BLE encryption / authentication fails - typically because of a
      stale or corrupted bond on either side - automatically unpair
      that peripheral. The next connection attempt will then do a
      fresh just-works pairing instead of refusing the link.

      Pair this with CONFIG_BT_SMP_ALLOW_UNAUTH_OVERWRITE=y on the
      peripherals so they accept the dongle's new keys to overwrite
      their own stale bond. With both ends configured the link
      self-heals from a bond desync without any reflash or
      settings_reset UF2.

      Successful connections (the normal sleep/wake cycle on a
      battery half) are not affected - they fire
      security_changed(SUCCESS) which is ignored. Incoming host
      connections (e.g. HID over BLE) are also ignored; only
      outgoing central-role connections (split peripherals) are
      acted on.

if DONGLE_BOND_AUTOHEAL

config DONGLE_BOND_AUTOHEAL_COOLDOWN_MS
    int "Per-peer cooldown between unpair attempts (ms)"
    default 30000
    help
      Minimum time, in milliseconds, between unpair attempts for
      the same peer address. Prevents pathological loops if pairing
      keeps failing for an unrelated reason.

module = DONGLE_BOND_AUTOHEAL
module-str = dongle_bond_autoheal
source "subsys/logging/Kconfig.template.log_config"

endif # DONGLE_BOND_AUTOHEAL


config PERIPHERAL_BOOT_BONDCLEAR
    bool "Peripheral: clear bonds at boot when a key combo is held"
    depends on BT && ZMK_SPLIT && !ZMK_SPLIT_ROLE_CENTRAL
    help
      On a split peripheral, watch for a specific two-key combo and
      unpair all bonds (including the bond with the central) when
      it is held. On the next reconnect the peripheral has no stored
      bond, so SMP does a fresh just-works pairing - which clears
      any stale CCC / GATT state on the central side too.

      Two trigger modes are provided:

        * Boot window - the combo is sampled during a short window
          right after cold boot. Procedure for the user:
            1. Flip the half's power switch OFF.
            2. Hold the two designated trigger keys.
            3. Flip the power switch back ON, keep holding ~2 s.
            4. Release. The half re-pairs on its next connection.

        * Panic hold - the combo is also sampled at any time during
          normal operation. If both trigger keys are held
          simultaneously for PERIPHERAL_BOOT_BONDCLEAR_HOLD_MS
          milliseconds without either being released, the unpair
          fires. This is the in-session recovery path for the
          "link up but no input flows" failure mode that the
          dongle-side auto-heal cannot detect on its own (because
          security_changed fires with SUCCESS and the desync is at
          the GATT subscription layer above).

      The two trigger keys are designed to be the half's outer
      corners (top + bottom of the outermost column) for both
      easy recall and low false-trigger risk during normal typing.

if PERIPHERAL_BOOT_BONDCLEAR

config PERIPHERAL_BOOT_BONDCLEAR_WINDOW_MS
    int "Boot window during which the trigger combo is sampled (ms)"
    default 4000
    help
      How long after boot the trigger combo is watched for in
      "boot window" mode. After this elapses the boot-mode
      listener disarms; the always-on panic-hold mode below
      remains active. Generous default leaves room for slow
      kscan / BT host init.

config PERIPHERAL_BOOT_BONDCLEAR_HOLD_MS
    int "Panic-mode simultaneous-hold duration (ms, 0 to disable)"
    default 5000
    help
      Outside the boot window, both trigger keys must be held
      simultaneously and continuously for this many milliseconds
      before the unpair fires. Set to 0 to disable panic mode
      entirely (boot-window-only behavior).

      The default 5 seconds is well beyond any normal typing or
      hold-tap pattern, and the two outer-corner trigger keys are
      too far apart to be pressed accidentally by a resting hand,
      so false positives are extremely unlikely.

config PERIPHERAL_BOOT_BONDCLEAR_POS_A
    int "First trigger position (half-local matrix position)"
    default 0
    help
      Matrix position number for the first key of the trigger
      combo, as seen by THIS half's local kscan after the matrix
      transform. Set per-shield in each half's Kconfig.defconfig
      so the combo lands on physical "outer corner" keys on both
      halves despite the right half's col-offset = <6>.

config PERIPHERAL_BOOT_BONDCLEAR_POS_B
    int "Second trigger position (half-local matrix position)"
    default 24
    help
      Matrix position number for the second key of the trigger
      combo. See POS_A. The default pair (0, 24) maps to the
      LEFT half's top-outermost + bottom-outermost keys. The
      RIGHT half overrides to (11, 35).

module = PERIPHERAL_BOOT_BONDCLEAR
module-str = peripheral_boot_bondclear
source "subsys/logging/Kconfig.template.log_config"

endif # PERIPHERAL_BOOT_BONDCLEAR

endmenu
```

## config/dts/bindings/zmk,behavior-layer-sync.yaml
```yaml
description: |
  Carries the toggled (non-momentary) layer from the split central to peripherals so a
  peripheral display can show it. Global locality: invoking it on the central also runs it
  on every connected peripheral.

compatible: "zmk,behavior-layer-sync"

include: one_param.yaml
```

## config/layer_sync/Kconfig
```kconfig
config ZMK_LAYER_SYNC
    bool "Mirror the toggled layer to split peripherals for display"
    default y
    depends on ZMK_SPLIT && DT_HAS_ZMK_BEHAVIOR_LAYER_SYNC_ENABLED
```

## dts/bindings/zmk,behavior-battery-sync.yaml
```yaml
description: Mirror the right-half battery percentage, or 255 when unavailable, to split peripherals.

compatible: "zmk,behavior-battery-sync"

include: one_param.yaml
```

## trackpad/Kconfig
```kconfig
config ZMK_TRACKPAD_IDLE_SLEEP
    bool "Cirque sleep while ZMK is idle"
    depends on INPUT_PINNACLE && ZMK_POINTING
    depends on !ZMK_INPUT_PINNACLE_IDLE_SLEEPER
    help
      Apply verified sleep changes on the sensor worker, retry I/O failures, and
      reinitialize the sensor on activity or device resume after sleep. Wake
      includes calibration; keep the pad untouched during this transition.
      Do not combine with the upstream idle sleeper or devicetree sleep property.

config ZMK_TRACKPAD_RELIABLE_SPLIT
    bool "Complete-frame trackpad split delivery"
    default y if SHIELD_HILLSIDE_VIEW_RIGHT || SHIELD_HILLSIDE_VIEW_LEFT_CENTRAL || SHIELD_KEYBOARD_DONGLE
    depends on ZMK_INPUT_SPLIT && ZMK_SPLIT_BLE
    help
      Transfer complete pointer samples and button snapshots instead of independent
      axis notifications. Requires updated firmware on the peripheral and central.
```
