## boards/shields/keyboard_dongle/Kconfig.shield
```kconfig
# Keyboard Dongle shield Kconfig
# Recognize when this shield is in the build list.

config SHIELD_KEYBOARD_DONGLE
    def_bool $(shields_list_contains,keyboard_dongle)
```

## boards/shields/nice_view_battery/Kconfig.shield
```kconfig
config SHIELD_NICE_VIEW_BATTERY
    def_bool $(shields_list_contains,nice_view_battery)
```
